#include <freertos/FreeRTOS.h>
#include <freertos/semphr.h>
#include <driver/i2c.h>
#include <string.h>
#include <stdio.h>
#include <stdlib.h>
#include <stdint.h>
#include <math.h>
#include "esp_err.h"
#include <errno.h>
#include "esp_log.h"
#include "esp_system.h"
#include "gpio.h"
#include "ssd1306.h"

static uint8_t character[37][6] = {
    {0x00, 0xfc, 0x22, 0x22, 0xfc, 0x00}, {0x00, 0xfe, 0x92, 0x92, 0x7c, 0x00}, {0x00, 0x7c, 0x82, 0x82, 0x44, 0x00},   // ABC
    {0x00, 0xfe, 0x82, 0x82, 0x7c, 0x00}, {0x00, 0xfe, 0x92, 0x92, 0x82, 0x00}, {0x00, 0xfe, 0x12, 0x12, 0x02, 0x00},   // DEF
    {0x00, 0x7c, 0x82, 0xa2, 0x64, 0x00}, {0x00, 0xfe, 0x10, 0x10, 0xfe, 0x00}, {0x00, 0x82, 0xfe, 0x82, 0x00, 0x00},   // GHI
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    {0x00, 0x4c, 0x92, 0x92, 0x7c, 0x00}
};

static uint8_t upper[37][6] = {
{0x0, 0xf0, 0xc, 0xc, 0xf0, 0x0}, {0x0, 0xfc, 0xc, 0xc, 0xf0, 0x0}, {0x0, 0xf0, 0xc, 0xc, 0x30, 0x0}, 
{0x0, 0xfc, 0xc, 0xc, 0xf0, 0x0}, {0x0, 0xfc, 0xc, 0xc, 0xc, 0x0}, {0x0, 0xfc, 0xc, 0xc, 0xc, 0x0}, 
{0x0, 0xf0, 0xc, 0xc, 0x30, 0x0}, {0x0, 0xfc, 0x0, 0x0, 0xfc, 0x0}, {0x0, 0xc, 0xfc, 0xc, 0x0, 0x0}, 
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{0x0, 0xf0, 0xc, 0xc, 0xf0, 0x0}
};
static uint8_t lower[37][6] = {
{0x0, 0xff, 0xc, 0xc, 0xff, 0x0}, {0x0, 0xff, 0xc3, 0xc3, 0x3f, 0x0}, {0x0, 0x3f, 0xc0, 0xc0, 0x30, 0x0}, 
{0x0, 0xff, 0xc0, 0xc0, 0x3f, 0x0}, {0x0, 0xff, 0xc3, 0xc3, 0xc0, 0x0}, {0x0, 0xff, 0x3, 0x3, 0x0, 0x0}, 
{0x0, 0x3f, 0xc0, 0xcc, 0x3c, 0x0}, {0x0, 0xff, 0x3, 0x3, 0xff, 0x0}, {0x0, 0xc0, 0xff, 0xc0, 0x0, 0x0}, 
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{0x0, 0x30, 0xc3, 0xc3, 0x3f, 0x0}
};

uint8_t ssd1306_addr = 0x3c;
uint8_t buffer[512] = {0};

void command(uint8_t data) {
    i2c_cmd_handle_t cmd = i2c_cmd_link_create();
    i2c_master_start(cmd);

    i2c_master_write_byte(cmd, (ssd1306_addr << 1) | I2C_MASTER_WRITE, true);
    i2c_master_write_byte(cmd, 0x00, true);
    i2c_master_write_byte(cmd, data, true);
    i2c_master_stop(cmd);

    i2c_master_cmd_begin(I2C_NUM_0, cmd, 100 / portTICK_RATE_MS);
    i2c_cmd_link_delete(cmd);
}

void data(uint8_t data) {
    i2c_cmd_handle_t cmd = i2c_cmd_link_create();
    i2c_master_start(cmd);

    i2c_master_write_byte(cmd, (ssd1306_addr << 1) | I2C_MASTER_WRITE, true);
    i2c_master_write_byte(cmd, 0x40, true);
    i2c_master_write_byte(cmd, data, true);
    i2c_master_stop(cmd);

    i2c_master_cmd_begin(I2C_NUM_0, cmd, 100 / portTICK_RATE_MS);
    i2c_cmd_link_delete(cmd);
}

void setColAddress()
{
  command(SSD1306_COLUMNADDR); // 0x21 COMMAND
  command(0); // Column start address
  command(SSD1306_LCDWIDTH-1); // Column end address
}

void setPageAddress(int page)
{
  command(SSD1306_PAGEADDR); // 0x22 COMMAND
  command(page); // Start Page address
  command((SSD1306_LCDHEIGHT/8)-1);// End Page address
}

void init_ssd1306() {

    GPIO_SetPin(SSD1306_RST_GPIO, GPIO_MODE_OUTPUT);
    gpio_set_level(SSD1306_RST_GPIO, 1);
    vTaskDelay(1 / portTICK_RATE_MS);
    gpio_set_level(SSD1306_RST_GPIO, 0);
    vTaskDelay(10 / portTICK_RATE_MS);
    gpio_set_level(SSD1306_RST_GPIO, 1);
   
    // Init sequence for 128x64 OLED module
    command(SSD1306_DISPLAYOFF);                    // 0xAE

    command(SSD1306_SETDISPLAYCLOCKDIV);            // 0xD5
    command(0x80);                 // the suggested ratio 0x80
   
    command(SSD1306_SETMULTIPLEX);                  // 0xA8
    command(0x3F);
   
    command(SSD1306_SETDISPLAYOFFSET);              // 0xD3
    command(0x0);                                   // no offset
   
    command(SSD1306_SETSTARTLINE);// | 0x0);        // line #0
   
    command(SSD1306_CHARGEPUMP);                    // 0x8D
    command(0x14);  // using internal VCC
   
    command(SSD1306_MEMORYMODE);                    // 0x20
    command(0x00);          // 0x00 horizontal addressing
   
    command(SSD1306_SEGREMAP | 0x1); // rotate screen 180
   
    command(SSD1306_COMSCANDEC); // rotate screen 180
   
    command(SSD1306_SETCOMPINS);                    // 0xDA
    command(0x12);
   
    command(SSD1306_SETCONTRAST);                   // 0x81
    command(0xCF);
   
    command(SSD1306_SETPRECHARGE);                  // 0xd9
    command(0xF1);
   
    command(SSD1306_SETVCOMDETECT);                 // 0xDB
    command(0x40);
   
    command(SSD1306_DISPLAYALLON_RESUME);           // 0xA4
   
    command(SSD1306_NORMALDISPLAY);                 // 0xA6
 
    command(SSD1306_DISPLAYON);                     //switch on OLED
}


void TransferBuffer()
{
    uint16_t j;
 
    // set the Column and Page addresses to 0,0
    
    setColAddress();
    setPageAddress(0);

    i2c_cmd_handle_t cmd = i2c_cmd_link_create();
    i2c_master_start(cmd);

    i2c_master_write_byte(cmd, (ssd1306_addr << 1) | I2C_MASTER_WRITE, true);
    i2c_master_write_byte(cmd, 0x40, true);

    for (j = 0; j < 13; j++) {
        for (int k = 0; k < 6; k++) {
            i2c_master_write_byte(cmd, upper[j][k], true);
        }
    }
    
    i2c_master_stop(cmd);

    i2c_master_cmd_begin(I2C_NUM_0, cmd, 100 / portTICK_RATE_MS);
    i2c_cmd_link_delete(cmd);

    setColAddress();
    setPageAddress(1);

    cmd = i2c_cmd_link_create();
    i2c_master_start(cmd);

    i2c_master_write_byte(cmd, (ssd1306_addr << 1) | I2C_MASTER_WRITE, true);
    i2c_master_write_byte(cmd, 0x40, true);

    for (j = 0; j < 13; j++) {
        for (int k = 0; k < 6; k++) {
            i2c_master_write_byte(cmd, lower[j][k], true);
        }
    }
    
    i2c_master_stop(cmd);

    i2c_master_cmd_begin(I2C_NUM_0, cmd, 100 / portTICK_RATE_MS);
    i2c_cmd_link_delete(cmd);
}

void clearRow(int row) {
    
    setColAddress();
    setPageAddress(row);

    i2c_cmd_handle_t cmd = i2c_cmd_link_create();
    i2c_master_start(cmd);

    i2c_master_write_byte(cmd, (ssd1306_addr << 1) | I2C_MASTER_WRITE, true);
    i2c_master_write_byte(cmd, 0x40, true);

    for (int j = 0; j < 128; j++) {
        i2c_master_write_byte(cmd, 0x00, true);
    }
    
    i2c_master_stop(cmd);

    i2c_master_cmd_begin(I2C_NUM_0, cmd, 100 / portTICK_RATE_MS);
    i2c_cmd_link_delete(cmd);
}

void print_at_line(const char* line, int len, int line_n) {
    int page = 2 * line_n;
    clearRow(page);
    clearRow(page + 1);
    
    setColAddress();
    setPageAddress(page);

    i2c_cmd_handle_t cmd = i2c_cmd_link_create();
    i2c_master_start(cmd);

    i2c_master_write_byte(cmd, (ssd1306_addr << 1) | I2C_MASTER_WRITE, true);
    i2c_master_write_byte(cmd, 0x40, true);

    for (uint8_t j = 0; j < len && j < 22; j++) {
        for (int k = 0; k < 6; k++) {
            if (line[j] == ' ')
                i2c_master_write_byte(cmd, upper[26][k], true);
            else if (line[j] >= '0' && line[j] <= '9') {
                i2c_master_write_byte(cmd, upper[27 + line[j] - '0'][k], true);
            } else 
                i2c_master_write_byte(cmd, upper[line[j] - 'a'][k], true);
        }
    }
    
    i2c_master_stop(cmd);

    i2c_master_cmd_begin(I2C_NUM_0, cmd, 100 / portTICK_RATE_MS);
    i2c_cmd_link_delete(cmd);

    setColAddress();
    setPageAddress(page + 1);

    // print lower row

    cmd = i2c_cmd_link_create();
    i2c_master_start(cmd);

    i2c_master_write_byte(cmd, (ssd1306_addr << 1) | I2C_MASTER_WRITE, true);
    i2c_master_write_byte(cmd, 0x40, true);

    for (uint8_t j = 0; j < len && j < 22; j++) {
        for (int k = 0; k < 6; k++) {
            if (line[j] == ' ')
                i2c_master_write_byte(cmd, lower[26][k], true);
            else if (line[j] >= '0' && line[j] <= '9') {
                i2c_master_write_byte(cmd, lower[27 + line[j] - '0'][k], true);
            } else 
                i2c_master_write_byte(cmd, lower[line[j] - 'a'][k], true);
        }
    }
    
    i2c_master_stop(cmd);

    i2c_master_cmd_begin(I2C_NUM_0, cmd, 100 / portTICK_RATE_MS);
    i2c_cmd_link_delete(cmd);
}

void printline(const char* line, int len) {
    static uint8_t page = 0;

    print_at_line(line, len, page);

    page = (page + 1) % 4;
}

void lcd_main() {
    init_ssd1306();
    clearRow(0);
    clearRow(1);
    clearRow(2);
    clearRow(3);
    clearRow(4);
    clearRow(5);
    clearRow(6);
    clearRow(7);

    printline("welcome", 7);
    // TransferBuffer();
}